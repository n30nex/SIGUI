## sdkconfig.defaults
```kconfig
# MeshCore DeskOS D1L Phase 1 defaults.
# Seeed's SDK requires ESP-IDF v5.1.x for SenseCAP Indicator examples.
CONFIG_IDF_TARGET="esp32s3"
CONFIG_IDF_EXPERIMENTAL_FEATURES=y

CONFIG_ESPTOOLPY_FLASHMODE_QIO=y
CONFIG_ESPTOOLPY_FLASHFREQ_120M=y
CONFIG_ESPTOOLPY_FLASHSIZE_8MB=y
CONFIG_PARTITION_TABLE_CUSTOM=y
CONFIG_PARTITION_TABLE_CUSTOM_FILENAME="partitions_d1l.csv"
CONFIG_PARTITION_TABLE_FILENAME="partitions_d1l.csv"

CONFIG_LCD_BOARD_SENSECAP_INDICATOR_D1L=y
CONFIG_SENSECAP_INDICATOR_SCREEN_GX=y
# CONFIG_SENSECAP_INDICATOR_SCREEN_DX is not set
CONFIG_LCD_EVB_SCREEN_ROTATION_0=y
# Use Seeed's double-framebuffer/direct-mode RGB path. The D1L panel scans
# continuously, so small strip flushes can show split/stale columns on hardware.
CONFIG_LCD_AVOID_TEAR=y
CONFIG_LCD_LVGL_DIRECT_MODE=y
CONFIG_LCD_TASK_REFRESH_TIME=10
CONFIG_LV_COLOR_DEPTH_16=y
CONFIG_LV_FONT_MONTSERRAT_14=y
CONFIG_LV_FONT_MONTSERRAT_24=y
CONFIG_LV_USE_QRCODE=y
# The production shell creates enough labels/sheets that LVGL's fixed 32 KB
# object heap can panic before the app console starts. Use the ESP-IDF heap
# allocator, matching Seeed's heavier LVGL examples.
CONFIG_LV_MEM_CUSTOM=y

# The serial console runs on app_main and can perform SD-backed retained-store
# writes during validation, so keep explicit stack headroom for those commands.
CONFIG_ESP_MAIN_TASK_STACK_SIZE=8192

CONFIG_SPIRAM=y
CONFIG_SPIRAM_MODE_OCT=y
CONFIG_SPIRAM_FETCH_INSTRUCTIONS=y
CONFIG_SPIRAM_RODATA=y
CONFIG_SPIRAM_SPEED_120M=y

CONFIG_COMPILER_OPTIMIZATION_SIZE=y
CONFIG_FREERTOS_HZ=1000
CONFIG_ESP_TASK_WDT_EN=y
CONFIG_ESP_TASK_WDT_INIT=y
# CONFIG_ESP_TASK_WDT_PANIC is not set
CONFIG_ESP_TASK_WDT_TIMEOUT_S=5
CONFIG_ESP_TASK_WDT_CHECK_IDLE_TASK_CPU0=y
# CONFIG_ESP_TASK_WDT_CHECK_IDLE_TASK_CPU1 is not set

# Build Wi-Fi support for explicit user-enabled setup and map tile downloads.
# Runtime Wi-Fi remains off by default in DeskOS settings.
CONFIG_ESP_WIFI_ENABLED=y
CONFIG_BT_ENABLED=n
CONFIG_MBEDTLS_CERTIFICATE_BUNDLE=y
CONFIG_MBEDTLS_CERTIFICATE_BUNDLE_DEFAULT_FULL=y
```
